/*
 * Copyright (C) 2015-2019 Variscite Ltd. - https://www.variscite.com
 *
 * This program is free software; you can redistribute it and/or modify
 * it under the terms of the GNU General Public License version 2 as
 * published by the Free Software Foundation.
 */

#include "imx6ul-imx6ull-var-dart.dtsi"

&iomuxc {
	pinctrl-names = "default";
	pinctrl-0 = <&pinctrl_hog>;

	pinctrl_hog: hoggrp {
		fsl,pins = <
			MX6UL_PAD_SNVS_TAMPER4__GPIO5_IO04	0x1b0b0	/* BT Enable */
			MX6UL_PAD_SNVS_TAMPER6__GPIO5_IO06	0x03029	/* WLAN Enable */
			MX6UL_PAD_LCD_DATA16__GPIO3_IO21	0x1b0b0 /* RELAY_CTRL3 */
			MX6UL_PAD_LCD_DATA18__GPIO3_IO23	0x1b0b0	/* RELAY_CTRL4 */
			MX6UL_PAD_LCD_DATA20__GPIO3_IO25	0x1b0b0 /* RELAY_CTRL2 */
			MX6UL_PAD_LCD_DATA22__GPIO3_IO27	0x1b0b0 /* RELAY_CTRL1 */
		>;
	};

	pinctrl_enet1_gpio: enet1_gpiogrp {
		fsl,pins = <
			MX6UL_PAD_SNVS_TAMPER0__GPIO5_IO00	0x1b0b0 /* fec1 reset */
		>;
	};
};

&adc1 {
	vref-supply = <&touch_3v3_regulator>;
	status = "okay";
};
